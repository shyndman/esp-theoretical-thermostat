## sdkconfig.defaults
```kconfig
CONFIG_MAIN_TASK_STACK_SIZE=16384
CONFIG_BSP_DISPLAY_BRIGHTNESS_LEDC_CH=1
CONFIG_BSP_DISPLAY_LVGL_AVOID_TEAR=y
CONFIG_BSP_DISPLAY_LVGL_FULL_REFRESH=y
CONFIG_BSP_LCD_COLOR_FORMAT_RGB565=y
CONFIG_BSP_LCD_DPI_BUFFER_NUMS=3
CONFIG_BSP_LCD_MIPI_DSI_LANE_BITRATE_MBPS=1500
CONFIG_BSP_LCD_TYPE_720_1280_5_INCH_A=y
CONFIG_BSP_LCD_TYPE_800_1280_10_1_INCH=n
CONFIG_CACHE_L2_CACHE_256KB=y
CONFIG_CACHE_L2_CACHE_LINE_128B=y
CONFIG_COMPILER_OPTIMIZATION_PERF=n
CONFIG_LV_USE_PERF_MONITOR=y
CONFIG_LV_PERF_MONITOR_ALIGN_BOTTOM_RIGHT=y
CONFIG_COMPILER_OPTIMIZATION_SIZE=y
CONFIG_ESP_HOSTED_P4_DEV_BOARD_FUNC_BOARD=y
CONFIG_ESP_HOSTED_SDIO_RESET_ACTIVE_HIGH=y
CONFIG_ESP_TASK_WDT_EN=n
CONFIG_ESPTOOLPY_FLASHSIZE_16MB=y
CONFIG_ESPTOOLPY_FLASHSIZE="16MB"
CONFIG_FREERTOS_HZ=1000
CONFIG_FREERTOS_TIMER_TASK_STACK_DEPTH=4096
CONFIG_FREERTOS_TASK_CREATE_ALLOW_EXT_MEM=y
CONFIG_IDF_EXPERIMENTAL_FEATURES=y
CONFIG_IDF_TARGET="esp32p4"
CONFIG_LOG_DEFAULT_LEVEL_INFO=y
CONFIG_LV_ATTRIBUTE_FAST_MEM_USE_IRAM=n
CONFIG_LV_COLOR_DEPTH_16=y
CONFIG_LV_COLOR_DEPTH=16
CONFIG_LV_CONF_SKIP=y
CONFIG_LV_DEF_REFR_PERIOD=15
CONFIG_LV_DRAW_BUF_ALIGN=64
CONFIG_LV_DRAW_SW_DRAW_UNIT_CNT=2
CONFIG_LV_LOG_LEVEL_INFO=y
CONFIG_LV_LOG_PRINTF=y
CONFIG_LV_MEM_SIZE_KILOBYTES=256
CONFIG_LV_OBJ_STYLE_CACHE=y
CONFIG_LV_OS_FREERTOS=y
CONFIG_LV_USE_CLIB_MALLOC=y
CONFIG_LV_USE_CLIB_SPRINTF=y
CONFIG_LV_USE_CLIB_STRING=y
CONFIG_LV_USE_FLEX=y
CONFIG_LV_USE_GRID=n
CONFIG_LV_USE_LOG=n
CONFIG_LV_USE_CALENDAR_HEADER_ARROW=n
CONFIG_LV_USE_CALENDAR_HEADER_DROPDOWN=n
CONFIG_LV_USE_OBSERVER=y
CONFIG_LV_USE_CANVAS=y
CONFIG_LV_USE_CHART=n
CONFIG_LV_USE_CHECKBOX=n
CONFIG_LV_USE_DROPDOWN=n
CONFIG_LV_USE_IMAGE=y
CONFIG_LV_USE_IMAGEBUTTON=y
CONFIG_LV_USE_KEYBOARD=n
CONFIG_LV_USE_LABEL=y
CONFIG_LV_LABEL_TEXT_SELECTION=n
CONFIG_LV_LABEL_LONG_TXT_HINT=n
CONFIG_LV_LABEL_WAIT_CHAR_COUNT=3
CONFIG_LV_USE_LED=n
CONFIG_LV_USE_LINE=n
CONFIG_LV_USE_LIST=n
CONFIG_LV_USE_MENU=n
CONFIG_LV_USE_MSGBOX=n
CONFIG_LV_USE_ROLLER=n
CONFIG_LV_USE_SCALE=n
CONFIG_LV_USE_SLIDER=y
CONFIG_LV_USE_SPAN=n
CONFIG_LV_SPAN_SNIPPET_STACK_SIZE=64
CONFIG_LV_USE_SPINBOX=n
CONFIG_LV_USE_SPINNER=n
CONFIG_LV_USE_SWITCH=y
CONFIG_LV_USE_TEXTAREA=n
CONFIG_LV_TEXTAREA_DEF_PWD_SHOW_TIME=1500
CONFIG_LV_USE_TABLE=n
CONFIG_LV_USE_TABVIEW=n
CONFIG_LV_USE_TILEVIEW=n
CONFIG_LV_USE_WIN=n
CONFIG_LV_BUILD_EXAMPLES=n
CONFIG_LV_BUILD_DEMOS=n
# Keep the LVGL FPS overlay enabled; do not remove.
CONFIG_ESP_LVGL_ADAPTER_ENABLE_FPS_STATS=y
CONFIG_LWIP_DNS_MAX_HOST_IP=1
CONFIG_LWIP_DNS_MAX_SERVERS=3
CONFIG_LWIP_DNS_SETSERVER_WITH_NETIF=y
CONFIG_LWIP_FALLBACK_DNS_SERVER_ADDRESS="192.168.84.3"
CONFIG_LWIP_FALLBACK_DNS_SERVER_SUPPORT=y
CONFIG_LWIP_TCP_RECVMBOX_SIZE=64
CONFIG_LWIP_TCP_SACK_OUT=y
CONFIG_LWIP_TCP_SND_BUF_DEFAULT=65534
CONFIG_LWIP_TCP_WND_DEFAULT=65534
CONFIG_LWIP_TCPIP_RECVMBOX_SIZE=64
CONFIG_LWIP_UDP_RECVMBOX_SIZE=64
CONFIG_MQTT_TRANSPORT_SSL=n
CONFIG_MQTT_TRANSPORT_WEBSOCKET=y
CONFIG_SLAVE_IDF_TARGET_ESP32C6=y
CONFIG_SPIRAM_SPEED_200M=y
CONFIG_SPIRAM_XIP_FROM_PSRAM=y
CONFIG_SPIRAM=y
CONFIG_SPIRAM_USE_CAPS_ALLOC=y
# CONFIG_SPIRAM_USE_MALLOC is not set
CONFIG_SPIRAM_TRY_ALLOCATE_WIFI_LWIP=y
CONFIG_SPIRAM_ALLOW_BSS_SEG_EXTERNAL_MEMORY=y
CONFIG_SPIRAM_ALLOW_NOINIT_SEG_EXTERNAL_MEMORY=y
CONFIG_SPIRAM_MALLOC_ALWAYSINTERNAL=0
CONFIG_SPIRAM_MALLOC_RESERVE_INTERNAL=8192
CONFIG_WIFI_RMT_AMPDU_RX_ENABLED=y
CONFIG_WIFI_RMT_AMPDU_TX_ENABLED=y
CONFIG_WIFI_RMT_DYNAMIC_RX_BUFFER_NUM=64
CONFIG_WIFI_RMT_DYNAMIC_TX_BUFFER_NUM=64
CONFIG_WIFI_RMT_RX_BA_WIN=32
CONFIG_WIFI_RMT_STATIC_RX_BUFFER_NUM=16
CONFIG_WIFI_RMT_TX_BA_WIN=32

# Camera (OV5647 via MIPI-CSI)
CONFIG_CAMERA_OV5647=y
CONFIG_CAMERA_OV5647_MIPI_RAW10_1280X960_BINNING_45FPS=y

# Screen burn-in protection
CONFIG_THEO_ANTIBURN_DURATION_SECONDS=30
CONFIG_THEO_ANTIBURN_SCHEDULE_START_MINUTE=240
CONFIG_THEO_ANTIBURN_SCHEDULE_STOP_MINUTE=241

# Backlight
CONFIG_THEO_BACKLIGHT_DAY_BRIGHTNESS_PERCENT=100
CONFIG_THEO_BACKLIGHT_NIGHT_BRIGHTNESS_PERCENT=70
CONFIG_THEO_BACKLIGHT_OVERNIGHT_END_MINUTES=390
CONFIG_THEO_BACKLIGHT_TIMEOUT_SECONDS=30
CONFIG_THEO_BACKLIGHT_PRESENCE_MAX_SECONDS=60

# Networking & MQTT
CONFIG_THEO_DNS_OVERRIDE_ADDR="192.168.84.3"
CONFIG_THEO_WIFI_STA_STATIC_IP_ENABLE=y
CONFIG_THEO_WIFI_STA_STATIC_IP="192.168.85.28"
CONFIG_THEO_WIFI_STA_STATIC_NETMASK="255.255.252.0"
CONFIG_THEO_WIFI_STA_STATIC_GATEWAY="192.168.86.1"
CONFIG_THEO_OTA_PORT=3232
CONFIG_THEO_MQTT_HOST="ha-mosquitto-ws.don"
CONFIG_THEO_MQTT_PATH="/"
CONFIG_THEO_MQTT_PORT=80
CONFIG_THEO_WIFI_STA_PASSWORD=""
CONFIG_THEO_WIFI_STA_SSID=""

# Time zone
CONFIG_THEO_TZ_STRING="EST5EDT,M3.2.0,M11.1.0"

# Audio Cues
CONFIG_THEO_AUDIO_ENABLE=y
CONFIG_THEO_AUDIO_I2S_LRCLK_GPIO=20
CONFIG_THEO_AUDIO_I2S_BCLK_GPIO=21
CONFIG_THEO_AUDIO_I2S_DATA_GPIO=22
CONFIG_THEO_AUDIO_MAX98357_SDMODE_GPIO=23
CONFIG_THEO_BOOT_CHIME_ENABLE=y
CONFIG_THEO_BOOT_CHIME_VOLUME=8
CONFIG_THEO_QUIET_HOURS_START_MINUTE=1380
CONFIG_THEO_QUIET_HOURS_END_MINUTE=416

# LED Notifications
CONFIG_THEO_LED_ENABLE=y
CONFIG_THEO_LED_STRIP_GPIO=49

# Camera & Streaming
CONFIG_THEO_IR_LED_GPIO=4
CONFIG_THEO_MJPEG_STREAM_FPS=5

# Radar Presence Sensor (LD2410C) - uses ld2410 component's Kconfig
CONFIG_LD2410_UART_PORT_NUM=2
CONFIG_LD2410_UART_RX=38
CONFIG_LD2410_UART_TX=37
CONFIG_LD2410_UART_BAUD_RATE=256000

# Environment sensors
CONFIG_THEO_I2C_ENV_SDA_GPIO=50
CONFIG_THEO_I2C_ENV_SCL_GPIO=52

# Device diagnostics
CONFIG_THEO_DIAG_POLL_SECONDS=30

# Custom partition table with OTA slots
CONFIG_PARTITION_TABLE_CUSTOM=y
CONFIG_PARTITION_TABLE_CUSTOM_FILENAME="partitions.csv"
CONFIG_BOOTLOADER_APP_ROLLBACK_ENABLE=y
CONFIG_APP_ROLLBACK_ENABLE=y

# MQTT
CONFIG_THEO_HA_BASE_TOPIC="homeassistant"
CONFIG_THEO_THEOSTAT_BASE_TOPIC="theostat"

# Disable bootloader logging to avoid early boot crash
CONFIG_BOOTLOADER_LOG_LEVEL_NONE=y
```
