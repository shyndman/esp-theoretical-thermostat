## main/Kconfig.projbuild
```kconfig
menu "Thermostat Connectivity"

menu "Wi-Fi Station"
	config THEO_WIFI_STA_SSID
		string "Wi-Fi SSID"
		default ""
		help
			SSID for the infrastructure network the thermostat connects to.

	config THEO_WIFI_STA_PASSWORD
		string "Wi-Fi Passphrase"
		default ""
		help
			Passphrase for the Wi-Fi network. Leave empty for open networks.

	config THEO_WIFI_STA_STATIC_IP_ENABLE
		bool "Enable static IPv4 for Wi-Fi STA"
		default n
		help
			When enabled, the Wi-Fi STA interface uses the static IP settings
			below instead of DHCP.

	config THEO_WIFI_STA_STATIC_IP
		string "Static IPv4 address"
		default ""
		depends on THEO_WIFI_STA_STATIC_IP_ENABLE
		help
			IPv4 address for the Wi-Fi STA interface (dotted-quad).

	config THEO_WIFI_STA_STATIC_NETMASK
		string "Static IPv4 netmask"
		default ""
		depends on THEO_WIFI_STA_STATIC_IP_ENABLE
		help
			IPv4 netmask for the Wi-Fi STA interface (dotted-quad).

	config THEO_WIFI_STA_STATIC_GATEWAY
		string "Static IPv4 gateway"
		default ""
		depends on THEO_WIFI_STA_STATIC_IP_ENABLE
		help
			IPv4 gateway for the Wi-Fi STA interface (dotted-quad).
endmenu

menu "Over-the-Air Updates"

config THEO_OTA_PORT
	int "OTA HTTP port"
	range 1 65535
	default 3232
	help
		Port for the OTA HTTP server that receives firmware uploads.

endmenu

menu "MQTT Broker"

config THEO_MQTT_HOST
	string "MQTT host"
	default ""
	help
		Hostname (or IPv4 address) for the broker reachable from the UI MCU.

config THEO_MQTT_PORT
	int "MQTT WebSocket port"
	range 1 65535
	default 9001
	help
		TCP port exposed by the broker for plain WebSocket (`ws://`) transports.

config THEO_MQTT_PATH
	string "MQTT WebSocket path"
	default "/mqtt"
	help
		Path portion appended to the `ws://host:port` URI (set blank for none).

config THEO_HA_BASE_TOPIC
	string "Home Assistant base topic"
	default "homeassistant"
	help
		Root topic the thermostat uses for Home Assistant payloads. All
		subscriptions and publishes derive from this prefix so deployments can
		re-target namespaces without code changes.

config THEO_DNS_OVERRIDE_ADDR
	string "Override DNS server (IPv4)"
	default ""
	help
		Optional dotted-quad IPv4 address to force as DNS[0] for the Wi-Fi STA netif.

endmenu

menu "Display & Backlight"

config THEO_BACKLIGHT_TIMEOUT_SECONDS
	int "Screen timeout (seconds)"
	range 1 600
	default 30
	help
		Time in seconds before the UI idles the backlight. Defaults to 30s.

config THEO_BACKLIGHT_DAY_BRIGHTNESS_PERCENT
	int "Daytime brightness (%)"
	range 1 100
	default 100
	help
		Brightness to apply when daypart logic considers it daytime.

config THEO_BACKLIGHT_NIGHT_BRIGHTNESS_PERCENT
	int "Nighttime brightness (%)"
	range 1 100
	default 70
	help
		Brightness to apply overnight/quiet hours.

config THEO_BACKLIGHT_OVERNIGHT_END_MINUTES
	int "Overnight ends at minute-of-day"
	range 0 1439
	default 390
	help
		Minute-of-day when night mode ends (390 = 06:30).

config THEO_ANTIBURN_DURATION_SECONDS
	int "Antiburn duration (seconds)"
	range 5 3600
	default 30
	help
		Run length for the antiburn/pixel training routine. Short for test cycles.

config THEO_ANTIBURN_SCHEDULE_START_MINUTE
	int "Schedule start minute-of-day"
	range 0 1439
	default 240
	help
		Minute-of-day to begin the scheduled antiburn routine (240 = 04:00).

config THEO_ANTIBURN_SCHEDULE_STOP_MINUTE
	int "Schedule stop minute-of-day"
	range 0 1439
	default 241
	help
		Minute-of-day to end the scheduled antiburn routine (241 = 04:01).

endmenu

menu "Device Identity & MQTT Namespace"

config THEO_DEVICE_SLUG
	string "Device slug"
	default "hallway"
	help
		Lowercase alphanumeric slug (plus dashes) identifying this thermostat
		installation. Used to derive the Theo-owned MQTT base topic and Home
		Assistant discovery identifiers. Example: hallway, bedroom, main-floor.

config THEO_DEVICE_FRIENDLY_NAME
	string "Device friendly name"
	default ""
	help
		Human-readable name for UI and Home Assistant device metadata. When
		blank, defaults to title-cased version of the device slug.

config THEO_THEOSTAT_BASE_TOPIC
	string "Theo-owned base topic"
	default "theostat"
	help
		Root topic for device-originated publishes (sensor telemetry, commands).
		When blank, auto-derives as "theostat". Leading slashes are stripped
		and trailing slashes are normalized.

endmenu

menu "Environmental Sensors"

config THEO_I2C_ENV_SDA_GPIO
	int "I2C SDA GPIO"
	range 0 52
	default 50
	help
		GPIO used for the environmental sensor I2C bus SDA line. Defaults to
		GPIO50 per the FireBeetle 2 ESP32-P4 wiring.

config THEO_I2C_ENV_SCL_GPIO
	int "I2C SCL GPIO"
	range 0 52
	default 52
	help
		GPIO used for the environmental sensor I2C bus SCL line. Defaults to
		GPIO52 per the FireBeetle 2 ESP32-P4 wiring.

config THEO_SENSOR_POLL_SECONDS
	int "Sensor polling interval (seconds)"
	range 1 600
	default 20
	help
		How frequently the environmental sensors are sampled. Values are
		published to MQTT when MQTT is connected; otherwise cached locally.

config THEO_SENSOR_LOG_INTERVAL_SECONDS
	int "Sensor log interval (seconds)"
	range 1 3600
	default 20
	help
		How frequently environmental sensor readings are logged. Sampling and
		MQTT publishing still occur at the poll interval.

config THEO_SENSOR_FAIL_THRESHOLD
	int "Consecutive failure threshold"
	range 1 10
	default 3
	help
		Number of consecutive sensor read failures before marking the sensor
		offline and publishing an unavailability message.

endmenu

menu "Device Diagnostics"

config THEO_DIAG_POLL_SECONDS
	int "Diagnostics polling interval (seconds)"
	range 5 3600
	default 30
	help
		How frequently the device diagnostic telemetry (chip temperature, RSSI,
		free heap) is published to MQTT.

endmenu

menu "Radar Presence Sensor"

config THEO_RADAR_ENABLE
	bool "Enable radar presence sensor"
	default y
	help
		Master switch for the LD2410C radar stack. When disabled, the
		sensor driver, MQTT telemetry, and backlight wake logic are all
		skipped so the rest of the system can run without the radar.

config THEO_RADAR_POLL_INTERVAL_MS
	int "Presence poll interval (ms)"
	range 50 500
	default 100
	help
		How often the backlight manager checks radar presence state.
		Lower values = faster wake response, higher CPU usage.

config THEO_RADAR_WAKE_DISTANCE_CM
	int "Wake trigger distance (cm)"
	range 20 500
	default 100
	help
		Proximity distance below which radar can trigger backlight wake.

config THEO_RADAR_WAKE_DWELL_MS
	int "Dwell time before wake (ms)"
	range 100 5000
	default 1000
	help
		Sustained presence duration below wake distance to trigger backlight.

config THEO_RADAR_FAIL_THRESHOLD
	int "Consecutive timeouts before offline"
	range 1 10
	default 3
	help
		Number of consecutive frame timeouts before marking radar offline.

config THEO_BACKLIGHT_PRESENCE_MAX_SECONDS
	int "Presence hold max (seconds)"
	range 60 3600
	default 60
	help
		Maximum continuous presence-hold duration before forcing the backlight to sleep
		and setting presence_ignored.

endmenu

config THEO_TZ_STRING
	string "POSIX timezone (TZ) string"
	help
		TZ value used by setenv()/tzset(). Example: EST5EDT,M3.2.0,M11.1.0.

menu "Audio Cues"

config THEO_AUDIO_ENABLE
	bool "Enable application audio cues"
	default y
	help
		Master switch for non-safety application sounds (boot chime, failure tone,
		and future UI cues). When disabled, the codec still initializes for
		diagnostics but all playback requests are skipped.

config THEO_BOOT_CHIME_ENABLE
	bool "Enable boot chime"
	default y
	help
		When enabled, the thermostat plays the compiled-in boot chime once per boot
		(provided the reboot does not happen during quiet hours).

choice THEO_AUDIO_PIPELINE_CHOICE
	prompt "Audio output pipeline"
	depends on THEO_AUDIO_ENABLE
	default THEO_AUDIO_PIPELINE_MAX98357
	help
		Select the audio hardware path compiled into the firmware. The FireBeetle 2
		ESP32-P4 harness uses an external MAX98357 amplifier by default; the legacy
		Waveshare Nano BSP codec remains available for compatibility.

config THEO_AUDIO_PIPELINE_NANO_BSP
	bool "NANO BSP codec"
	help
		Target the Waveshare ESP32-P4 Nano BSP’s integrated ES8311 speaker codec.
		Use this option only when flashing the Nano-based thermostat build.

config THEO_AUDIO_PIPELINE_MAX98357
	bool "MAX98357 I2S amp"
	help
	Route audio to the FireBeetle harness’s discrete MAX98357 I2S amplifier using
			the ESP32-P4 I2S TX peripheral. Requires wiring LRCLK, BCLK, and DATA per
			`CONFIG_THEO_AUDIO_I2S_*` pins.

endchoice

config THEO_AUDIO_I2S_LRCLK_GPIO
	int "MAX98357 LRCLK GPIO"
	depends on THEO_AUDIO_PIPELINE_MAX98357
	range 0 52
	default 20
	help
		GPIO driving the MAX98357 LRCLK (word-select). Defaults to GPIO20.

config THEO_AUDIO_I2S_BCLK_GPIO
	int "MAX98357 BCLK GPIO"
	depends on THEO_AUDIO_PIPELINE_MAX98357
	range 0 52
	default 21
	help
		GPIO driving the MAX98357 BCLK line. Defaults to GPIO21.

config THEO_AUDIO_I2S_DATA_GPIO
	int "MAX98357 DATA GPIO"
	depends on THEO_AUDIO_PIPELINE_MAX98357
	range 0 52
	default 22
	help
		GPIO carrying the audio data stream toward the MAX98357 amplifier. Defaults to
		GPIO22.

config THEO_AUDIO_MAX98357_SDMODE_GPIO
	int "MAX98357 SD/MODE GPIO"
	depends on THEO_AUDIO_PIPELINE_MAX98357
	range 0 52
	default 23
	help
		GPIO driving the MAX98357 SD/MODE (shutdown) pin. Drive HIGH to enable
		the amplifier, LOW to shut it down. Defaults to GPIO23.

config THEO_BOOT_CHIME_VOLUME
	int "Boot chime volume (%)"
	range 0 100
	default 8
	help
		Percentage passed to the active audio pipeline before playback (ES8311 gain
		for the Waveshare codec path, PCM scaling for the FireBeetle/MAX98357 path).
		70%% roughly matches the speaker’s comfortable volume; set lower for labs.

config THEO_QUIET_HOURS_START_MINUTE
	int "Quiet hours start (minute-of-day)"
	range 0 1439
	default 1380
	help
		Minute-of-day (local time) when quiet hours begin; application cues are
		suppressed during quiet hours when time is synchronized. 1380 = 23:00.

config THEO_QUIET_HOURS_END_MINUTE
	int "Quiet hours end (minute-of-day)"
	range 0 1439
	default 420
	help
		Minute-of-day (local time) when quiet hours end; windows may wrap across
		midnight. 420 = 07:00.

endmenu

menu "Camera & Streaming"

config THEO_CAMERA_ENABLE
	bool "Enable camera streaming"
	default y
	help
		Master switch for the OV5647 camera pipeline. When disabled, no
		camera initialization or streaming tasks are started.

config THEO_WEBRTC_ENABLE
	bool "Enable WebRTC publisher"
	depends on THEO_CAMERA_ENABLE
	default y
	help
		Enable the esp_webrtc-based publisher that streams OV5647 video to
		go2rtc/Frigate via WHIP.

config THEO_WEBRTC_HOST
	string "WebRTC WHIP host"
	depends on THEO_WEBRTC_ENABLE
	default "nvr.don"
	help
		Host (no scheme) that serves the go2rtc WHIP endpoint.

config THEO_WEBRTC_PORT
	int "WebRTC WHIP port"
	depends on THEO_WEBRTC_ENABLE
	range 1 65535
	default 1984
	help
		TCP port exposed by go2rtc for WHIP HTTP requests.

config THEO_WEBRTC_PATH
	string "WebRTC WHIP path"
	depends on THEO_WEBRTC_ENABLE
	default "/api/webrtc"
	help
		Path portion appended to the WHIP URL.

config THEO_WEBRTC_STREAM_ID
	string "WebRTC WHIP stream id"
	depends on THEO_WEBRTC_ENABLE
	default "thermostat"
	help
		Stream identifier passed via the `dst` query parameter when hitting
		the WHIP endpoint.

config THEO_WEBRTC_FORCE_FIXED_CAPS
	bool "Force OV5647 fixed caps (YUV422 1280x960@target fps)"
	depends on THEO_WEBRTC_ENABLE
	default n
	help
		When enabled, the WebRTC streamer calls the capture driver's set_fixed_caps
		with a YUV422 1280x960 profile at the configured target fps before bringing
		the sink online. Disable to let esp_capture negotiate caps dynamically.

config THEO_CAMERA_SCCB_SDA_GPIO
	int "Camera SCCB SDA GPIO"
	depends on THEO_CAMERA_ENABLE
	range 0 52
	default 7
	help
		GPIO used for the camera SCCB (I2C) SDA line. Defaults to GPIO7 per
		the FireBeetle 2 ESP32-P4 CSI connector.

config THEO_CAMERA_SCCB_SCL_GPIO
	int "Camera SCCB SCL GPIO"
	depends on THEO_CAMERA_ENABLE
	range 0 52
	default 8
	help
		GPIO used for the camera SCCB (I2C) SCL line. Defaults to GPIO8 per
		the FireBeetle 2 ESP32-P4 CSI connector.

config THEO_IR_LED_GPIO
	int "IR LED GPIO"
	depends on THEO_CAMERA_ENABLE
	range 0 52
	default 4
	help
		GPIO for the IR LED (active-high). The LED is only enabled while the
		camera streaming pipeline is active.

endmenu

menu "LED Notifications"

config THEO_LED_ENABLE
	bool "Enable LED diffuser notifications"
	default y
	help
		Master switch for the WS2812 LED strip used for application cues. Disable
		when lab hardware lacks the diffuser or when visual cues should be off.

config THEO_LED_STRIP_GPIO
	int "LED strip data GPIO"
	range 0 52
	default 49
	help
		GPIO connected to the WS2812 data-in line. GPIO 33 is the diffuser design's
		baseline; adjust per board routing.

endmenu

endmenu
```
